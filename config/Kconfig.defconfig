## config/Kconfig.defconfig
```kconfig
# Copyright (c) 2021 The ZMK Contributors
# SPDX-License-Identifier: MIT
if SHIELD_TIEN_LEFT

config ZMK_KEYBOARD_NAME
	default "Tien"

config ZMK_SPLIT_ROLE_CENTRAL
	default y

endif

if SHIELD_TIEN_LEFT || SHIELD_TIEN_RIGHT

config ZMK_SPLIT
	default y

endif
```

## config/boards/shields/tien/Kconfig.shield
```kconfig
# Copyright (c) 2021 The ZMK Contributors
# SPDX-License-Identifier: MIT
config SHIELD_TIEN_LEFT
	def_bool $(shields_list_contains,tien_left)

config SHIELD_TIEN_RIGHT
	def_bool $(shields_list_contains,tien_right)
```
